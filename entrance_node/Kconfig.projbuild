## entrance_node/Kconfig.projbuild
```kconfig
/**
 * @file Kconfig.projbuild
 * @brief Entrance Hub configuration.
 * @author Opiyo Oscar
 * @requirements FR-DST-02, FR-DST-05
 */

menu "CoCIS Networking"

config COCIS_WIFI_SSID
    string "Wi-Fi SSID"
    default "Wokwi-GUEST"

config COCIS_WIFI_PASSWORD
    string "Wi-Fi password"
    default ""
    help
        Leave empty for the open Wokwi-GUEST network.

config COCIS_MQTT_URI
    string "MQTT broker URI"
    default "mqtt://broker.hivemq.com:1883"

config COCIS_GROUP_PREFIX
    string "MQTT group topic prefix"
    default "cocis26-oscar-a91f"
    help
        Unique prefix so our topics do not collide with other groups on a
        public broker. Must be identical on every node.

endmenu
```

## entrance_node/sdkconfig.defaults
```kconfig
CONFIG_IDF_TARGET="esp32"
CONFIG_ESPTOOLPY_FLASHSIZE_4MB=y
CONFIG_PARTITION_TABLE_CUSTOM=y
CONFIG_PARTITION_TABLE_CUSTOM_FILENAME="partitions.csv"
CONFIG_ESP_SYSTEM_EVENT_TASK_STACK_SIZE=6144
```

## room_node/Kconfig.projbuild
```kconfig
menu "CoCIS Room Node"

config COCIS_ROOM_ID
    int "Room number (1 or 2)"
    range 1 2
    default 1
    help
        Identifies this room node. Room 1 and Room 2 run the same firmware
        and differ only by this configured value.

endmenu
```

## room_node/main/Kconfig.projbuild
```kconfig
#
# @file Kconfig.projbuild
# @brief Room node configuration (room id + shared networking).
# @author Opiyo Oscar
# @requirements FR-DST-02, FR-DST-05
#

menu "CoCIS Room Node"

config COCIS_ROOM_ID
    int "Room number (1 or 2)"
    range 1 2
    default 1
    help
        Identifies this room node. Room 1 and Room 2 run the same firmware
        and differ only by this configured value.

endmenu

menu "CoCIS Networking"

config COCIS_WIFI_SSID
    string "Wi-Fi SSID"
    default "Wokwi-GUEST"

config COCIS_WIFI_PASSWORD
    string "Wi-Fi password"
    default ""
    help
        Leave empty for the open Wokwi-GUEST network.

config COCIS_MQTT_URI
    string "MQTT broker URI"
    default "mqtt://broker.hivemq.com:1883"

config COCIS_GROUP_PREFIX
    string "MQTT group topic prefix"
    default "cocis26-oscar-a91f"
    help
        Unique prefix so our topics do not collide with other groups on a
        public broker. Must be identical on every node.

endmenu
```

## room_node/sdkconfig.defaults.room2
```kconfig
CONFIG_IDF_TARGET="esp32"
CONFIG_COCIS_ROOM_ID=2
CONFIG_ESPTOOLPY_FLASHSIZE_4MB=y
CONFIG_PARTITION_TABLE_CUSTOM=y
CONFIG_PARTITION_TABLE_CUSTOM_FILENAME="partitions.csv"
```
